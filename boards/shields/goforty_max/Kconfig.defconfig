## boards/shields/goforty_max/Kconfig.defconfig
```kconfig
if SHIELD_GOFORTY_MAX

config ZMK_KEYBOARD_NAME
    default "goforty-max"

endif
```

## config/west.yml
```yaml
manifest:
  remotes:
    - name: sekigon-gonnoc
      url-base: https://github.com/sekigon-gonnoc
  projects:
    - name: zmk
      url: https://github.com/zmkfirmware/zmk
      revision: main
      import: app/west.yml
    - name: zmk-feature-non-lipo-battery-management
      remote: sekigon-gonnoc
      revision: main
  self:
    path: config
```
